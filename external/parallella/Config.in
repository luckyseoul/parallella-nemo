## external/parallella/Config.in
```kconfig
source "$BR2_EXTERNAL_PARALLELLA_PATH/package/etop/Config.in"
source "$BR2_EXTERNAL_PARALLELLA_PATH/package/firstboot/Config.in"
source "$BR2_EXTERNAL_PARALLELLA_PATH/package/explorer/Config.in"
source "$BR2_EXTERNAL_PARALLELLA_PATH/package/aggregator/Config.in"
source "$BR2_EXTERNAL_PARALLELLA_PATH/package/fpga-loader/Config.in"
source "$BR2_EXTERNAL_PARALLELLA_PATH/package/epiphany/Config.in"
```

## external/parallella/defconfig
```kconfig
# Parallella Nemo - Base Configuration
BR2_arm=y
BR2_cortex_a9=y

BR2_TOOLCHAIN_EXTERNAL=y

BR2_LINUX_KERNEL=y
BR2_LINUX_KERNEL_DEFCONFIG="xilinx_zynq"

BR2_SYSTEM_DHCP="eth0"
BR2_TARGET_GENERIC_HOSTNAME="parallella"

BR2_PACKAGE_PYTHON3=y
BR2_PACKAGE_DIALOG=y
BR2_PACKAGE_NCURSES=y
BR2_PACKAGE_WPA_SUPPLICANT=y
BR2_PACKAGE_SYSTEMD=y

# Epiphany SDK
BR2_PACKAGE_HOST_EPIPHANY_SDK=y

# Packages
BR2_PACKAGE_ETOP=y
BR2_PACKAGE_FIRSTBOOT=y
BR2_PACKAGE_EXPLORER=y
BR2_PACKAGE_AGGREGATOR=y

# Useful tools
BR2_PACKAGE_HTOP=y
BR2_PACKAGE_DROPBEAR=y
BR2_PACKAGE_GIT=y
```

## external/parallella/package/aggregator/Config.in
```kconfig
config BR2_PACKAGE_AGGREGATOR
	bool "aggregator"
	select BR2_PACKAGE_PYTHON3
	help
	  Parallel Idea Engine aggregator for Parallella Nemo.
```

## external/parallella/package/epiphany/Config.in
```kconfig
config BR2_PACKAGE_EPIPHANY
	bool "epiphany"
	help
	  Epiphany kernel examples and tools for Parallella.
```

## external/parallella/package/explorer/Config.in
```kconfig
config BR2_PACKAGE_EXPLORER
	bool "explorer"
	help
	  Parallel Idea Engine core for Parallella Nemo.
```

## external/parallella/package/firstboot/Config.in
```kconfig
config BR2_PACKAGE_FIRSTBOOT
	bool "firstboot"
	help
	  First-boot setup wizard for Parallella Nemo.
```

## external/parallella/package/fpga-loader/Config.in
```kconfig
config BR2_PACKAGE_FPGA_LOADER
	bool "fpga-loader"
	help
	  FPGA bitstream loader for Parallella (Zynq).
```
